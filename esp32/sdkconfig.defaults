## esp32/sdkconfig.defaults
```kconfig
# DDL Reminder — ESP32-S3 SDK Configuration
CONFIG_IDF_TARGET="esp32s3"

# Flash — 16MB
CONFIG_ESPTOOLPY_FLASHMODE_QIO=y
CONFIG_ESPTOOLPY_FLASHSIZE_16MB=y

# Custom partition table
CONFIG_PARTITION_TABLE_CUSTOM=y
CONFIG_PARTITION_TABLE_CUSTOM_FILENAME="partitions.csv"
CONFIG_PARTITION_TABLE_FILENAME="partitions.csv"
CONFIG_PARTITION_TABLE_OFFSET=0x8000
CONFIG_PARTITION_TABLE_MD5=y

# CPU — 240MHz
CONFIG_ESP_DEFAULT_CPU_FREQ_MHZ_240=y

# PSRAM — 8MB octal
CONFIG_SPIRAM=y
CONFIG_SPIRAM_MODE_OCT=y
CONFIG_SPIRAM_TYPE_AUTO=y
CONFIG_SPIRAM_SPEED_80M=y
CONFIG_SPIRAM_BOOT_INIT=y
CONFIG_SPIRAM_USE_MALLOC=y
CONFIG_SPIRAM_MALLOC_ALWAYSINTERNAL=4096
CONFIG_SPIRAM_MALLOC_RESERVE_INTERNAL=49152

# LVGL — use PSRAM for display buffers
CONFIG_LV_COLOR_DEPTH_16=y
CONFIG_LV_MEM_CUSTOM=n
CONFIG_LV_USE_PERF_MONITOR=n

# LED Strip — RMT only (disable SPI backend)
CONFIG_LED_STRIP_RMT_EN=y

# Task stack sizes
CONFIG_ESP_MAIN_TASK_STACK_SIZE=10240
CONFIG_ESP_SYSTEM_EVENT_TASK_STACK_SIZE=4096

# FreeRTOS
CONFIG_FREERTOS_HZ=1000

# Compiler — optimize for size
CONFIG_COMPILER_OPTIMIZATION_SIZE=y

# Logger
CONFIG_LOG_DEFAULT_LEVEL_INFO=y
CONFIG_LOG_MAXIMUM_EQUALS_DEFAULT=y

# I2C — suppress legacy driver deprecation warning (migrate to i2c_master.h later)
CONFIG_I2C_SUPPRESS_DEPRECATE_WARN=y
```
